## meta-eddaaf/conf/layer.conf
```bitbake
# We have a conf and classes directory, add to BBPATH
BBPATH .= ":${LAYERDIR}"

# We have recipes-* directories, add to BBFILES
BBFILES += "${LAYERDIR}/recipes-*/*/*.bb \
            ${LAYERDIR}/recipes-*/*/*.bbappend"

BBFILE_COLLECTIONS += "meta-eddaaf"
BBFILE_PATTERN_meta-eddaaf = "^${LAYERDIR}/"
BBFILE_PRIORITY_meta-eddaaf = "6"

LAYERDEPENDS_meta-eddaaf = "core"
LAYERSERIES_COMPAT_meta-eddaaf = "kirkstone"
```
